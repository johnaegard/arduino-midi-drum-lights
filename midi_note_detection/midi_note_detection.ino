#include <MIDI.h>
#include <limits.h>

MIDI_CREATE_DEFAULT_INSTANCE();

#define LED 13                   // LED pin on Arduino Uno

#define KICK 36
#define SNARE 38
#define SNARE_RIM 40
#define XSTICK 37
#define TOM1 48
#define TOM1_RIM 50
#define TOM2 45
#define TOM2_RIM 47
#define TOM3 43
#define TOM3_RIM 58
#define HIHAT_OPEN 46
#define HIHAT_OPEN_RIM 26
#define HIHAT_CLOSED 42
#define HIHAT_CLOSED_RIM 22
#define HIHAT_PEDAL 44
#define CRASH1 49
#define CRASH1_EDGE 55
#define CRASH2 57
#define CRASH2_EDGE 52
#define RIDE 51
#define RIDE_EDGE 59
#define RIDE_BELL 53

void on()      // Basic blink function
{
  digitalWrite(LED,HIGH);
}

void off()
{
  digitalWrite(LED,LOW);
}

// ----------------------------------------------------------------------------

const int RED = 11;
const int GREEN =9;
const int BLUE = 10;
const float DECAY = 0.32;

void setup()
{
  MIDI.setHandleNoteOn(handleNoteOn);
  MIDI.setHandleNoteOff(handleNoteOff);

  pinMode(LED, OUTPUT);
  MIDI.begin(MIDI_CHANNEL_OMNI); 
  pinMode(RED,OUTPUT);
  pinMode(GREEN,OUTPUT);
  pinMode(BLUE,OUTPUT);
}

float fBrightness=0;
float red=0;
float green=0;
float blue=0;
long notesReceived=0;
int reds[]   = { 
  255 , 128,  0,   255, 128,  0};
int greens[] = {  
  255,  0, 128, 255, 0,   0};
int blues[]  = {  
  50,    0,   0,   255, 128, 128};
int brights[]= {  
  .75,   0, 0, .75, 0, 0};
int colorsetCounter=0;
int colorset=0;

void handleNoteOn(byte channel, byte pitch, byte velocity){

  on();

  switch(pitch) {
  case CRASH2_EDGE:
    red=0;
    green=1;
    blue=0;
    break;
  case CRASH2:
    red=1;
    green=0;
    blue=0;
    break;
  default:
    red=0;
    green=0;
    blue=0;
    break;
  }
  float fCandidateBrightness=velocity*1.5;
  if (fCandidateBrightness < fBrightness ) {
    fBrightness += 32;
  }
  else {
    fBrightness = fCandidateBrightness;
  }

}

void handleNoteOff(byte channel, byte pitch, byte velocity){
  off();
}

void loop(){
  MIDI.read();
  fBrightness = fBrightness - .03;
  if ( fBrightness < 0 ) {
    fBrightness = 0;
  }
  else if ( fBrightness > 255 ) {
    fBrightness = 255;
  }
  setLed(red,green,blue,fBrightness);
}

void setLed(float r, float g, float b, float fB) {
  analogWrite(RED,   linearBrightness(r*fB));
  analogWrite(GREEN, linearBrightness(g*fB));
  analogWrite(BLUE,  linearBrightness(b*fB));
}

const byte LINEAR_BRIGHTNESS_TABLE[] = {
  0x00, 0x00, 0x00, 0x00, 0x00, 0x00, 0x00, 0x00, 0x00, 0x00, 0x01, 0x01, 0x01, 0x01, 0x01, 0x01, 
  0x01, 0x01, 0x01, 0x01, 0x01, 0x01, 0x01, 0x01, 0x01, 0x02, 0x02, 0x02, 0x02, 0x02, 0x02, 0x02,
  0x02, 0x02, 0x03, 0x03, 0x03, 0x03, 0x03, 0x03, 0x04, 0x04, 0x04, 0x04, 0x04, 0x05, 0x05, 0x05,
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  0xFD, 0xFD, 0xFD, 0xFD, 0xFD, 0xFD, 0xFD, 0xFE, 0xFE, 0xFE, 0xFE, 0xFE, 0xFE, 0xFE, 0xFF, 0xFF};

byte linearBrightness(byte rawBrightness) {
  return LINEAR_BRIGHTNESS_TABLE[rawBrightness];
}


